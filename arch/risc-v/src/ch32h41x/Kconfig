## arch/risc-v/src/ch32h41x/Kconfig
```kconfig
#
# For a description of the syntax of this configuration file,
# see the file kconfig-language.txt in the NuttX tools repository.
#

comment "CH32H41x Configuration Options"

choice
	prompt "CH32H41x Core Selection"
	default CH32H41X_CORE_V3F

config CH32H41X_CORE_V3F
	bool "V3F core (boot master core, recommended)"
	---help---
		Run NuttX on the V3F core.  The V3F is the hardware boot
		master; it configures the clocks and can boot the V5F later.

config CH32H41X_CORE_V5F
	bool "V5F core (experimental)"
	depends on EXPERIMENTAL
	---help---
		Run NuttX on the V5F core.  The V5F is woken by the V3F with
		the clocks already running.  This configuration is a
		placeholder and is not functional yet.

endchoice # CH32H41x Core Selection

config CH32H41X_HSE_VALUE
	int "HSE crystal frequency (Hz)"
	default 25000000

choice
	prompt "SYSCLK Configuration"
	default CH32H41X_SYSCLK_480MHZ

config CH32H41X_SYSCLK_480MHZ
	bool "SYSCLK=480MHz (USBHS PLL): V5F=240MHz, V3F=HCLK=120MHz"
	---help---
		480MHz SYSCLK from the USBHS PLL with a 25MHz HSE reference.
		Keeps the USBHS/USBSS PLLs available for later USB support.
		V5F core runs at 240MHz (SYSCLK/HPRE); HCLK = 120MHz and the
		V3F core and peripherals all run at HCLK.

config CH32H41X_SYSCLK_400MHZ
	bool "SYSCLK=400MHz (SYSPLL x16): V5F=400MHz, V3F=HCLK=100MHz"
	---help---
		400MHz SYSCLK from the main SYSPLL (HSE * 16).  V5F core runs
		at 400MHz (SYSCLK/HPRE); HCLK = 100MHz and the V3F core and
		peripherals all run at HCLK.

endchoice # SYSCLK Configuration

config CH32H41X_FLASH_SIZE
	int "Flash window for this core (bytes)"
	default 524288
	---help---
		The code flash window used by this core's image.  The family
		members differ in flash size (CH32H417: 960KiB in DBMODE=1).
		When both cores are used, split the flash so the images do
		not overlap (V3F at 0x0, V5F after it).

config CH32H41X_RAM_SIZE
	int "RAM size for this core (bytes)"
	default 524288
	---help---
		Size of the RAM window used by this core (CH32H417: 512KiB
		shared SRAM at 0x20100000 for V3F, ITCM 128KiB for V5F).

menu "CH32H41x Peripheral Support"

config CH32H41X_HAVE_USART1
	bool "USART1"
	select CH32H41X_USART1
	select ARCH_HAVE_UART1
	select UART1_SERIALDRIVER
	select ARCH_HAVE_SERIAL_TERMIOS

config CH32H41X_USART1
	bool
	default n

config CH32H41X_HAVE_USART2
	bool "USART2"
	select CH32H41X_USART2
	select ARCH_HAVE_UART2
	select UART2_SERIALDRIVER
	select ARCH_HAVE_SERIAL_TERMIOS

config CH32H41X_USART2
	bool
	default n

config CH32H41X_HAVE_USART3
	bool "USART3"
	select CH32H41X_USART3
	select ARCH_HAVE_UART3
	select UART3_SERIALDRIVER
	select ARCH_HAVE_SERIAL_TERMIOS

config CH32H41X_USART3
	bool
	default n

config CH32H41X_HAVE_USART4
	bool "USART4"
	select CH32H41X_USART4
	select ARCH_HAVE_UART4
	select UART4_SERIALDRIVER
	select ARCH_HAVE_SERIAL_TERMIOS

config CH32H41X_USART4
	bool
	default n

config CH32H41X_HAVE_USART5
	bool "USART5"
	select CH32H41X_USART5
	select ARCH_HAVE_UART5
	select UART5_SERIALDRIVER
	select ARCH_HAVE_SERIAL_TERMIOS

config CH32H41X_USART5
	bool
	default n

config CH32H41X_HAVE_USART6
	bool "USART6"
	select CH32H41X_USART6
	select ARCH_HAVE_UART6
	select UART6_SERIALDRIVER
	select ARCH_HAVE_SERIAL_TERMIOS

config CH32H41X_USART6
	bool
	default n

config CH32H41X_HAVE_USART7
	bool "USART7"
	select CH32H41X_USART7
	select ARCH_HAVE_UART7
	select UART7_SERIALDRIVER
	select ARCH_HAVE_SERIAL_TERMIOS

config CH32H41X_USART7
	bool
	default n

config CH32H41X_HAVE_USART8
	bool "USART8"
	select CH32H41X_USART8
	select ARCH_HAVE_UART8
	select UART8_SERIALDRIVER
	select ARCH_HAVE_SERIAL_TERMIOS

config CH32H41X_USART8
	bool
	default n

config CH32H41X_HAVE_EXTI
	bool "EXTI (external interrupt lines)"
	select CH32H41X_EXTI
	---help---
		External interrupt controller support, used by the GPIO
		character driver for interrupt-capable pins.

config CH32H41X_EXTI
	bool
	default n

config CH32H41X_HAVE_IWDG
	bool "IWDG (independent watchdog)"
	select CH32H41X_IWDG
	---help---
		Independent watchdog (LSI-clocked) exposed as
		/dev/watchdog0 through the NuttX watchdog driver.

config CH32H41X_IWDG
	bool
	default n
	select WATCHDOG
	select WATCHDOG_ANONYMOUS

config CH32H41X_HAVE_TIM1_PWM
	bool "TIM1 PWM output (advanced timer, 4 channels)"
	select CH32H41X_TIM
	select CH32H41X_PWM
	select CH32H41X_TIM1_PWM
	select PWM
	select PWM_MULTICHAN
	---help---
		Expose TIM1 as /dev/pwm0.  TIM1 is the advanced timer with
		dead-time generation hardware for the complementary outputs.

config CH32H41X_HAVE_TIM2_CAPTURE
	bool "TIM2 PWM-input capture (frequency/duty measurement)"
	select CH32H41X_TIM
	select CH32H41X_TIM2_CAPTURE
	select CAPTURE
	---help---
		Expose TIM2 channel 1 as /dev/capture0 in PWM-input mode.

config CH32H41X_HAVE_TIM3_PWM
	bool "TIM3 PWM output (CH1 = PA6 AF2)"
	select CH32H41X_TIM
	select CH32H41X_PWM
	select CH32H41X_TIM3_PWM
	select PWM
	select PWM_MULTICHAN
	---help---
		Expose TIM3 as an additional /dev/pwmN.  CH1 muxes on PA6
		(AF2), which is shared with SPI1 MISO -- enabling both SPI1
		and TIM3 PWM drives PA6 from the PWM (bringup muxes PWM pins
		after SPI).  Enable only one of them at a time.

config CH32H41X_HAVE_TIM4_PWM
	bool "TIM4 PWM output (CH1 = PB6 AF2)"
	select CH32H41X_TIM
	select CH32H41X_PWM
	select CH32H41X_TIM4_PWM
	select PWM
	select PWM_MULTICHAN
	---help---
		Expose TIM4 as an additional /dev/pwmN.  CH1 muxes on PB6
		(AF2), which is shared with I2C1 SCL (the SPL06 barometer
		wire).  Enable only one of them at a time.

config CH32H41X_HAVE_TIM5_PWM
	bool "TIM5 PWM output (CH1 = PC1 AF2, free on EVB)"
	select CH32H41X_TIM
	select CH32H41X_PWM
	select CH32H41X_TIM5_PWM
	select PWM
	select PWM_MULTICHAN
	---help---
		Expose TIM5 as an additional /dev/pwmN.  CH1 muxes on PC1
		(AF2), which is unused by the nsh configuration, so TIM5
		can be verified with a PC1 -> PA0 jumper to the capture.

config CH32H41X_HAVE_TIM8_PWM
	bool "TIM8 PWM output (CH1 = PC6 AF3, free on EVB)"
	select CH32H41X_TIM
	select CH32H41X_PWM
	select CH32H41X_TIM8_PWM
	select PWM
	select PWM_MULTICHAN
	---help---
		Expose TIM8 as an additional /dev/pwmN.  CH1 muxes on PC6
		(AF3), which is unused by the nsh configuration, so TIM8
		can be verified with a PC6 -> PA0 jumper to the capture.
		TIM8 is the second advanced timer (dead-time capable).

config CH32H41X_HAVE_TIM9_PWM
	bool "TIM9 PWM output (CH1 = PC9 AF6)"
	select CH32H41X_TIM
	select CH32H41X_PWM
	select CH32H41X_TIM9_PWM
	select PWM
	select PWM_MULTICHAN
	---help---
		Expose TIM9 as an additional /dev/pwmN.  CH1 muxes on PC9
		(AF6).

config CH32H41X_HAVE_TIM10_PWM
	bool "TIM10 PWM output (CH1 = PB6 AF0, conflicts I2C1)"
	select CH32H41X_TIM
	select CH32H41X_PWM
	select CH32H41X_TIM10_PWM
	select PWM
	select PWM_MULTICHAN
	---help---
		Expose TIM10 as an additional /dev/pwmN.  CH1 muxes on PB6
		(AF0), which is shared with I2C1 SCL -- enable only one of
		I2C1 and TIM10 PWM at a time.

config CH32H41X_HAVE_TIM11_PWM
	bool "TIM11 PWM output (CH1 = PD3 AF2)"
	select CH32H41X_TIM
	select CH32H41X_PWM
	select CH32H41X_TIM11_PWM
	select PWM
	select PWM_MULTICHAN
	---help---
		Expose TIM11 as an additional /dev/pwmN.  CH1 muxes on PD3
		(AF2).

config CH32H41X_HAVE_TIM12_PWM
	bool "TIM12 PWM output (CH1 = PB1 AF5, free on EVB)"
	select CH32H41X_TIM
	select CH32H41X_PWM
	select CH32H41X_TIM12_PWM
	select PWM
	select PWM_MULTICHAN
	---help---
		Expose TIM12 as an additional /dev/pwmN.  CH1 muxes on PB1
		(AF5), which is one of the gpio-test pins, so TIM12 can be
		verified with a PB1 -> PA0 jumper to the capture.

config CH32H41X_TIM
	bool
	default n

config CH32H41X_PWM
	bool
	default n

config CH32H41X_TIM2_CAPTURE
	bool
	default n

config CH32H41X_TIM1_PWM
	bool
	default n

config CH32H41X_TIM3_PWM
	bool
	default n

config CH32H41X_TIM4_PWM
	bool
	default n

config CH32H41X_TIM5_PWM
	bool
	default n

config CH32H41X_TIM8_PWM
	bool
	default n

config CH32H41X_TIM9_PWM
	bool
	default n

config CH32H41X_TIM10_PWM
	bool
	default n

config CH32H41X_TIM11_PWM
	bool
	default n

config CH32H41X_TIM12_PWM
	bool
	default n

endmenu # CH32H41x Peripheral Support

config CH32H41X_HAVE_ADC1
	bool "ADC1 (internal temperature + Vrefint channels)"
	select CH32H41X_ADC
	---help---
		ADC1 support exposed as /dev/adc0.  The conversion group
		covers the internal temperature-sensor and Vrefint
		channels so the device can be verified without any
		external wiring.  ADC clock comes from the USBHS PLL
		(480MHz/6) following the vendor reference sequence.

config CH32H41X_ADC
	bool
	default n
	select ADC

config CH32H41X_ADC_DMA
	bool "ADC1 DMA scan path (DMA1_CH1, one scan per ANIOC_TRIGGER)"
	default y
	depends on CH32H41X_ADC
	select CH32H41X_DMA
	---help---
		Move the regular group scan with DMA1 channel 1 (DMAMUX
		request 0x78, EVT ADC_DMA sequence).  Falls back to the
		per-channel polled path when the DMA channel is unavailable.

config CH32H41X_DMA
	bool "DMA controller support (DMA1/DMA2 channel manager)"
	default n
	---help---
		Register-level channel manager for the two DMA controllers
		(8 channels each) including the request multiplexer.  Used
		by drivers that transfer through DMA; standalone it only
		provides the allocation/config/poll API.

config CH32H41X_HAVE_CAN1
	bool "CAN1 (bxCAN, loopback capable)"
	select CH32H41X_CAN1
	---help---
		CAN1 support exposed as /dev/can0 at 500kbit/s.  The
		driver starts in loopback mode so the controller can be
		verified without a transceiver; switch to normal mode at
		runtime via CANIOC_SET_CONNMODES.  NOTE: the version-A
		silicon does not implement the hardware filter banks, so
		every frame is delivered to the application (vendor uses
		software filtering in the EVT examples too).

config CH32H41X_CAN1
	bool
	default n
	select CAN

config CH32H41X_HAVE_SPI1
	bool "SPI1 master (PA5 SCK / PA6 MISO / PA7 MOSI, AF5)"
	select CH32H41X_SPI1
	---help---
		SPI1 master exposed as /dev/spi1 (spitool -b 1).  Polled
		full-duplex transfers, 8/16-bit frames, mode 0-3.  Pins
		per the CH32H417DS0 pin table, all AF5.

config CH32H41X_SPI1
	bool
	default n
	select SPI
	select SPI_EXCHANGE

config CH32H41X_HAVE_I2C
	bool "I2C controllers (I2C1/I2C2 master)"
	select CH32H41X_I2C
	---help---
		I2C1 and I2C2 as masters: /dev/i2c0 (PB6/PB7, AF4) and
		/dev/i2c1 (PC0/PC1, AF9).  Requires external pull-ups on
		the bus lines.  The I2C2 hardware-slave responder is
		experimental (see CH32H41X_I2C2_SLAVE) and is OFF by
		default: its TXE level interrupt can storm when a master
		read aborts mid-transfer.
	---help---
		I2C support: I2C1 master on /dev/i2c0 (PB6/PB7, AF4) and
		I2C2 on /dev/i2c1 (PC0/PC1, AF9).  I2C2 additionally runs
		as a hardware slave at address 0x50 so the two controllers
		can exercise each other with two jumpers (PB6-PC0, PB7-PC1).

config CH32H41X_I2C
	bool
	default n
	select I2C
	select I2C_DRIVER

config CH32H41X_HAVE_ONESHOT
	bool "TIM6/TIM7 oneshot timer (/dev/oneshot/0)"
	select CH32H41X_ONESHOT
	---help---
		TIM7 basic timer as the NuttX oneshot lower half
		(/dev/oneshot/0).  100us resolution, maximum delay 6.55s.

config CH32H41X_ONESHOT
	bool
	default n
	select ONESHOT

config CH32H41X_I2C2_SLAVE
	bool "I2C2 hardware-slave responder at 0x50 (experimental)"
	default n
	---help---
		EXPERIMENTAL: makes I2C2 respond as a slave at 0x50 so the
		I2C1 master can self-test against it (jumpers PB6-PC0,
		PB7-PC1 plus pull-ups).  The slave TXE level interrupt can
		storm when a read aborts mid-transfer; the storm breaker in
		the ISR hardware-resets the peripheral as a safety net, but
		leave this OFF unless actively debugging the slave path.
```

## boards/risc-v/ch32h41x/ch32h41x-evb/configs/nsh/defconfig
```kconfig
CONFIG_HOST_WINDOWS=y
CONFIG_WINDOWS_MSYS=y
CONFIG_APPS_DIR="../NuttX-apps"
CONFIG_BASE_DEFCONFIG="ch32h41x-evb:nsh-dirty"
CONFIG_INTELHEX_BINARY=y
CONFIG_RAW_BINARY=y
# CONFIG_SCHED_DUMP_TASKS is not set
# CONFIG_SCHED_DUMP_STACK is not set
CONFIG_DEBUG_FEATURES=y
CONFIG_ARCH_RISCV=y
CONFIG_ARCH_CHIP_CH32H41X=y
CONFIG_RISCV_TOOLCHAIN_GNU_RV32=y
CONFIG_CH32H41X_HAVE_USART1=y
CONFIG_CH32H41X_HAVE_EXTI=y
CONFIG_CH32H41X_HAVE_IWDG=y
CONFIG_CH32H41X_HAVE_TIM1_PWM=y
CONFIG_CH32H41X_HAVE_TIM2_CAPTURE=y
CONFIG_ARCH_STACKDUMP=y
CONFIG_BOARD_LOOPSPERMSEC=47000
CONFIG_ARCH_INTERRUPTSTACK=2048
CONFIG_RAM_START=0x20100000
CONFIG_RAM_SIZE=524288
CONFIG_ARCH_BOARD_CH32H41X_EVB=y
CONFIG_DISABLE_MQUEUE_SYSV=y
CONFIG_START_YEAR=2026
CONFIG_START_MONTH=11
CONFIG_START_DAY=7
CONFIG_PREALLOC_TIMERS=4
CONFIG_INIT_STACKSIZE=3072
CONFIG_INIT_ENTRYPOINT="nsh_main"
CONFIG_RR_INTERVAL=200
CONFIG_TASK_NAME_SIZE=12
CONFIG_SCHED_WAITPID=y
CONFIG_PTHREAD_MUTEX_UNSAFE=y
CONFIG_SIG_PREALLOC_IRQ_ACTIONS=4
CONFIG_PREALLOC_MQ_MSGS=4
CONFIG_PREALLOC_MQ_IRQ_MSGS=4
CONFIG_DISABLE_MQUEUE_NOTIFICATION=y
CONFIG_IDLETHREAD_STACKSIZE=4096
CONFIG_PID_INITIAL_COUNT=8
CONFIG_DEV_GPIO=y
# CONFIG_DEV_NULL is not set
CONFIG_UART1_SERIAL_CONSOLE=y
CONFIG_DISABLE_PSEUDOFS_OPERATIONS=y
# CONFIG_FS_ANONMAP is not set
CONFIG_BINFMT_DISABLE=y
# CONFIG_LIBC_LONG_LONG is not set
CONFIG_LIBC_DISABLE_HEXSTR_TO_FLOAT=y
CONFIG_LINE_MAX=64
CONFIG_LIBC_STRERROR=y
CONFIG_LIBC_PERROR_STDOUT=y
CONFIG_LIBC_STRSIGNAL_SHORT=y
# CONFIG_LIBC_STRFTIME_C_STANDARD_FORMATS is not set
# CONFIG_LIBC_STRFTIME_NONSTANDARD_FORMATS is not set
CONFIG_LIBC_LOCALTIME=y
# CONFIG_LIBC_TEMPBUFFER is not set
CONFIG_BUILTIN=y
# CONFIG_LIBC_INLINE_QUEUE is not set
CONFIG_LIBM_NONE=y
CONFIG_EXAMPLES_CAPTURE=y
CONFIG_EXAMPLES_GPIO=y
CONFIG_EXAMPLES_HELLO=y
CONFIG_EXAMPLES_PWM=y
CONFIG_EXAMPLES_WATCHDOG=y
# CONFIG_NSH_ARGCAT is not set
# CONFIG_NSH_ALIAS is not set
CONFIG_NSH_BUILTIN_APPS=y
# CONFIG_NSH_DISABLE_BASENAME is not set
# CONFIG_NSH_DISABLE_DATE is not set
# CONFIG_NSH_DISABLE_DIRNAME is not set
# CONFIG_NSH_DISABLE_IFCONFIG is not set
# CONFIG_NSH_DISABLE_IFUPDOWN is not set
# CONFIG_NSH_DISABLE_LOSMART is not set
# CONFIG_NSH_DISABLE_LOMTD is not set
# CONFIG_NSH_DISABLE_MB is not set
# CONFIG_NSH_DISABLE_MH is not set
# CONFIG_NSH_DISABLE_MW is not set
# CONFIG_NSH_DISABLE_PS is not set
# CONFIG_NSH_DISABLE_TIMEDATECTL is not set
CONFIG_NSH_FILEIOSIZE=64
CONFIG_NSH_STRERROR=y
CONFIG_NSH_DISABLESCRIPT=y
CONFIG_NSH_ARCHINIT=y
# CONFIG_SYSTEM_DD is not set
CONFIG_SYSTEM_NSH=y
CONFIG_TESTING_OSTEST=y
```
